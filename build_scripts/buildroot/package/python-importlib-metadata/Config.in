## build_scripts/buildroot/package/python-importlib-metadata/Config.in
```kconfig
config BR2_PACKAGE_PYTHON_IMPORTLIB_METADATA
	bool "python-importlib-metadata"
	select BR2_PACKAGE_PYTHON_ZIPP
	help
	  Library to access Python package metadata.

	  https://github.com/python/importlib_metadata
```

## build_scripts/buildroot/package/python-inotify-simple/Config.in
```kconfig
config BR2_PACKAGE_PYTHON_INOTIFY_SIMPLE
	bool "python-inotify-simple"
	help
	  Minimal Python wrapper around Linux inotify.

	  https://github.com/chrisjbillington/inotify_simple
```

## build_scripts/buildroot/package/python-libnacl/Config.in
```kconfig
config BR2_PACKAGE_PYTHON_LIBNACL
	bool "python-libnacl"
	select BR2_PACKAGE_LIBSODIUM
	help
	  Python ctypes bindings for libsodium.

	  https://github.com/saltstack/libnacl
```

## build_scripts/buildroot/package/python-smart-open/Config.in
```kconfig
config BR2_PACKAGE_PYTHON_SMART_OPEN
	bool "python-smart-open"
	select BR2_PACKAGE_PYTHON_WRAPT
	help
	  Python library for streaming data from local and remote sources.

	  https://github.com/piskvorky/smart_open
```

## build_scripts/buildroot/package/python-streaming-form-data/Config.in
```kconfig
config BR2_PACKAGE_PYTHON_STREAMING_FORM_DATA
	bool "python-streaming-form-data"
	select BR2_PACKAGE_PYTHON_SMART_OPEN
	help
	  Streaming multipart/form-data parser for Python.

	  https://github.com/siddhantgoel/streaming-form-data
```

## build_scripts/buildroot/package/python-zipp/Config.in
```kconfig
config BR2_PACKAGE_PYTHON_ZIPP
	bool "python-zipp"
	help
	  pathlib-compatible wrapper for ZIP files.

	  https://github.com/jaraco/zipp
```
